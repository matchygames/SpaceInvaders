//// title: space invaders (remake)
//// by: matchy
//// for: matchygames color handheld v1.0 / arduino + tft display
//// date: August 2014

#include <pad.h>
#include <Adafruit_GFX.h>
#include <Adafruit_ST7735.h>
#include <SPI.h>

PROGMEM prog_uchar sprite_title[] = { // original SPACE INVADERS game cabinet captioning (filled)
	160, 64,
	B00000000,B00000000,B00000000,B00000000,B00000000,B00000000,B00001111,B11111100,B00000000,B00000000,B00000000,B00000000,B00000000,B00000000,B00000000,B00000000,B00000000,B00000000,B00000000,B00000000,
	B00000000,B00000000,B00000000,B00000000,B01111111,B11000000,B00111111,B11111111,B00000000,B00011111,B11111110,B00000000,B00011111,B11110000,B00000111,B11111111,B11111110,B00000000,B00000000,B00000000,
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	B00000000,B00000000,B01111100,B00111110,B00000000,B00000000,B01111110,B00000111,B11000000,B11100000,B00000000,B00000000,B00000000,B00000000,B00000000,B00000000,B00000000,B00000000,B00000000,B00000000,
};

PROGMEM prog_uchar sprite_title_outline[] = { // Original SPACE INVADERS game cabinet captioning (outline)
	160, 64,
	B00000000,B00000000,B00000000,B00000000,B00011111,B00000000,B00011111,B11111110,B00000000,B00000000,B00000000,B00000000,B00000111,B11000000,B00000000,B00000000,B00000000,B00000000,B00000000,B00000000,
	B00000000,B00000000,B00000000,B00000000,B11111111,B11100000,B00110000,B00000011,B10000000,B00111111,B11111111,B00000000,B00111111,B11111000,B00001111,B11111111,B11111110,B00000000,B00000000,B00000000,
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	B00000000,B00000000,B11111110,B01111111,B00000111,B00000011,B11111111,B00001111,B11100001,B11110000,B00000000,B00000000,B00000000,B00000000,B00000000,B00000000,B00000000,B00000000,B00000000,B00000000,
};

PROGMEM prog_uchar sprite_hackaday[] = { // hack-a-day logo & hackaday.io
	128,128,
	B00000000,B00000000,B00000000,B00000000,B00000000,B00000000,B00000000,B00000000,B00000000,B00000000,B00000000,B00000000,B00000000,B00000000,B00000000,B00000000,
	B00000000,B00000111,B11111100,B00000000,B00000000,B00000000,B00000000,B00000000,B00000000,B00000000,B00000000,B00000000,B00000000,B01111111,B11000000,B00000000,
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	B00000000,B00000000,B00000000,B00000000,B00000000,B00000000,B00000000,B00000000,B00000000,B00000000,B00000000,B00000000,B00000000,B00000000,B00000000,B00000000,
};

PROGMEM prog_uchar sprite_ufo[] = { // ufo ? mystery points (level * 100 points)
	24, 8,
	B00000000,B01111110,B00000000,
	B00000001,B11111111,B10000000,
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	B00000000,B00000000,B00000000
};

PROGMEM prog_uchar sprite_invader[] = {
	16, 12,
	B00000000,B00000000, // invader 10 points
	B00000000,B00000000,
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	B00010100,B00101000
};

PROGMEM prog_uchar sprite_ship[] = { // player / exploding x2
	16, 8,
	B00000000,B00000000,
	B00000001,B00000000,
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	B00111111,B11111000
};

PROGMEM prog_uchar sprite_projectile[] = { // invader projectile
	8, 8,
	B00000000,
	B00000000,
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	B00001000,
	B00010000
};

struct _group {
	int x;
	byte y;
	byte width;
	byte height;
	byte frame;
	byte last_x;
	byte last_y;
	int dir_x;
	int dir_y;
};
_group group;

struct _rect1 {
	int x;
	byte y;
	byte width;
	byte height;
	byte state;
};
_rect1 rect[46];

struct _rect2 {
	byte x;
	byte y;
	byte width;
	byte height;
	byte state;
};
_rect2 sprite;

struct _rect3 {
	byte x;
	int y;
	byte width;
	byte height;
	byte state;
	byte last_x;
	byte last_y;
	int dir_y;
};
_rect3 proj[10];
_rect3 ammo;

struct _rect4 {
	byte x;
	byte y;
	byte width;
	byte height;
	byte width2;
	byte height2;
	byte last_x;
	byte last_y;
	int dir_x;
	int dir_y;
};
_rect4 act;

struct _rect5 {
	int x;
	int y;
	int last_x;
	int last_y;
	int width;
	int height;
	int width2;
	int height2;
	int dir_x;
	int dir_y;
	byte state;
	int anim;
	int anim_alt;
	byte draw;
	byte frame;
};

#define TFT_CS				10
#define TFT_RST				7
#define TFT_DC				8
#define TFT_MOSI			11
#define TFT_SCK				13
#define TFT_LED				A0
#define TFT_SD				4
#define TFT_VCC				-1
#define TFT_GND				-1
#define SND_LEFT			3

#define	COL_BLACK			0x0001
#define COL_WHITE			0xFFFE
#define COL_NAVY			0x000F
#define COL_DARKGREEN		0x03E0
#define COL_DARKCYAN		0x03EF
#define COL_MAROON			0x7800
#define COL_PURPLE			0x780F
#define COL_OLIVE			0x7BE0
#define COL_LIGHTGRAY		0xC618
#define COL_DARKGRAY		0x7BEF
#define COL_BLUE			0x001F
#define COL_GREEN			0x07E0
#define COL_CYAN			0x07FF
#define COL_RED				0xF800
#define COL_MAGENTA			0xF81F
#define COL_YELLOW			0xFFE0
#define COL_ORANGE			0xFD20
#define COL_GREENYELLOW		0xAFE5

#define SCENE_TITLE			0
#define SCENE_INTRO			1
#define SCENE_ACTION		2
#define SCENE_OVER			3
#define SCENE_HISCORES		4
#define SCENE_ABOUT			5

#define PAL_BACKGROUND		0
#define PAL_FOREGROUND		1
#define PAL_INVADER1		2
#define PAL_INVADER2		3
#define PAL_INVADER3		4
#define PAL_UFO				5
#define PAL_SHIP			6
#define PAL_AMMO			7
#define PAL_PROJECTILE		8

#define INVADER1			0
#define INVADER2			1
#define INVADER3			2
#define INVADER_POP			3

Adafruit_ST7735 tft = Adafruit_ST7735(TFT_CS, TFT_DC, TFT_RST);
Button pad;
uint16_t sprite_color[9];
byte music_beat = 4;
byte ufo_effect = 0;
byte play_state = 0;
byte scene_id = 0;
byte sub_id = 0;
byte theme_id = 0;
boolean effects_on = false;
boolean music_on = false;
int ufo_effect_dir = 1;
int play_score = 0;
int high_score = 0;
int enemy_count = 0;
int ship_count = 0;
int level_count = 0;
int temp_timer = 0;

boolean is_collide(byte x, byte y, byte x0, byte y0, byte width, byte height) {
	byte x1 = x0 + width;
	byte y1 = y0 + height;
	byte ret_flag = false;
	if (x > x0 && x < x1 && y > y0 && y < y1) {
		ret_flag = true;
	}
	return ret_flag;
}

void refresh_score() {
	tft.setCursor(0, 0);
	tft.print("SCORE<1> HI-SCORE");
	tft.setCursor(10, 10);
	tft.print(play_score);
	tft.setCursor(66, 10);
	tft.print(high_score);
	if (ship_count > 0) {
		tft.setCursor(tft.width() - 48, 0);
		tft.print("LEVEL");
		tft.setCursor(tft.width() - 14, 0);
		tft.print(level_count);
		tft.setCursor(152, 10);
		tft.print(ship_count);
		for (byte i = 0; i < ship_count - 1; i++) {
			draw_sprite(sprite_ship, 0, tft.width() - (i * act.width) - 28, 10, sprite_color[PAL_SHIP], sprite_color[PAL_BACKGROUND]); // ship
		}
	}
}

void add_proj(byte x, byte y) {
	for (byte i = 0; i < 10; i++) {	
		if (proj[i].state == 0) {
			proj[i].dir_y = 1;
			proj[i].width = 2;
			proj[i].height = 4;
			proj[i].x = x;
			proj[i].y = y;
			proj[i].state = 1;
			break;
		}
	}
}

void end_game() {
	scene_id = SCENE_OVER;
	if (play_score > high_score) {
		high_score = play_score;
	}
	tft.fillScreen(sprite_color[PAL_BACKGROUND]);
	refresh_score();
}

void act_hit() {
	for (byte i = 0; i < 32; i++) {
		draw_sprite(sprite_ship, (i % 2) + 1, act.x, act.y, sprite_color[5], sprite_color[PAL_BACKGROUND]);
		if (effects_on) tone(SND_LEFT, random(300) + 300, 100); // player hit
	}
	tft.fillRect(act.x, act.y, act.width, act.height, sprite_color[PAL_BACKGROUND]);
	ship_count--;
	if (ship_count == 0) {
		end_game();
	} else {
		reset_retry();
	}
	play_state = 1;
}


void add_ammo(byte x, byte y) {
	ammo.x = x;
	ammo.y = y;
	ammo.state = 1;
}


void reset_retry() {
	reset_proj();
	reset_ammo();
	act.x = 0;
	play_state = 0;
	tft.fillScreen(sprite_color[PAL_BACKGROUND]);
	refresh_score();
}

void reset_proj() {
	for (byte i = 0; i < 10; i++) {
		proj[i].state = 0;
		proj[i].x = tft.width();
		proj[i].y = 0;
		proj[i].last_y = 0;
	}
}

void reset_ammo() {
	ammo.state = 0;
	ammo.x = tft.width();
	ammo.y = tft.height();
	ammo.last_x = ammo.x;
	ammo.last_y = ammo.y;
}

void reset_level() {
	byte j;
	for (byte i = 0; i < 46; i++) {
		j = 45 - i;
		if (j == 45) {
			rect[j].x = tft.width();
			rect[j].y = 20;
			rect[j].width = 24;
			rect[j].height = 8;
			rect[j].state = 0;
		} else {
			rect[j].x = ((i - 1) % group.width) * sprite.width;
			rect[j].y = ((i - 1) / group.width) * sprite.height;
			rect[j].width = 16;
			rect[j].height = 12;
			rect[j].state = 1;
		}
	}
	enemy_count = 45;
	act.x = 0;
	group.dir_x = 1;
	group.x = 0;
	group.y = 26;
	ammo.dir_y = -3;
	tft.fillScreen(sprite_color[PAL_BACKGROUND]);
	refresh_score();
}

void reset_game() {
	ship_count = 3;
	play_score = 0;
	level_count = 1;
}

void reset_theme() {
	switch (theme_id) {
		case 0:
			sprite_color[PAL_BACKGROUND] =	COL_BLACK;
			sprite_color[PAL_FOREGROUND] =	COL_WHITE;
			sprite_color[PAL_INVADER1] =	COL_CYAN;
			sprite_color[PAL_INVADER2] =	COL_YELLOW;
			sprite_color[PAL_INVADER3] =	COL_MAGENTA;
			sprite_color[PAL_UFO] =			COL_RED;
			sprite_color[PAL_SHIP] =		COL_GREEN;
			sprite_color[PAL_AMMO] =		COL_WHITE;
			sprite_color[PAL_PROJECTILE] =	COL_WHITE;
			break;
		case 1:
			sprite_color[PAL_BACKGROUND] =	COL_WHITE;
			sprite_color[PAL_FOREGROUND] =	COL_BLACK;
			sprite_color[PAL_INVADER1] =	COL_NAVY;
			sprite_color[PAL_INVADER2] =	COL_BLUE;
			sprite_color[PAL_INVADER3] =	COL_CYAN;
			sprite_color[PAL_UFO] =			COL_RED;
			sprite_color[PAL_SHIP] =		COL_DARKGREEN;
			sprite_color[PAL_AMMO] =		COL_BLACK;
			sprite_color[PAL_PROJECTILE] =	COL_BLACK;
			break;
		case 2:
			break;
	}
	tft.setTextColor(sprite_color[PAL_FOREGROUND], sprite_color[PAL_BACKGROUND]);
	tft.fillScreen(sprite_color[PAL_BACKGROUND]);
}


void init_rect() {
	reset_theme();
	sprite.width = 16;
	sprite.height = 12;
	group.width = 9;
	group.height = 5;
	act.width = 16;
	act.height = 8;
	act.y = tft.height() - act.height;
	act.width2 = act.width / 2;
	act.height2 = act.height / 2;
	ammo.width = 2;
	ammo.height = 3;
}

void init_display() {
	if (TFT_VCC > -1) {
		pinMode(TFT_VCC, OUTPUT);
		digitalWrite(TFT_GND, HIGH);
	}
	if (TFT_GND > -1) {
		pinMode(TFT_GND, OUTPUT);
		digitalWrite(TFT_GND, LOW);
	}
	if (TFT_LED > -1) {
		pinMode(TFT_LED, OUTPUT);
		analogWrite(TFT_LED, 255);
	}
	if (SND_LEFT > -1) {
		pinMode(SND_LEFT, OUTPUT);
	}
	tft.initR(INITR_BLACKTAB);
	tft.setRotation(3);
	tft.setTextWrap(false);
	tft.setTextSize(1);
}

void setup() {
	randomSeed(analogRead(0));
	pad.init();
	init_display();
	init_rect();
	splash_matchygames();
}



void paint_ammo() {
	int y;
	if (ammo.state == 2) add_ammo(act.x + (act.width2), act.y - ammo.height);
	if (ammo.state == 1) {
		tft.drawRect(ammo.last_x, ammo.last_y + ammo.height, ammo.width, abs(ammo.dir_y), sprite_color[PAL_BACKGROUND]);
		tft.drawRect(ammo.x, ammo.y, ammo.width, ammo.height, sprite_color[PAL_AMMO]);
		ammo.last_x = ammo.x;
		ammo.last_y = ammo.y;
		y = ammo.y + ammo.dir_y;
		if (y < -ammo.height * 2) {
			ammo.y = 0;
			ammo.last_y = 0;
			ammo.state = 0;
			tft.drawRect(ammo.last_x, ammo.last_y, ammo.width, ammo.height + 1, sprite_color[PAL_BACKGROUND]);
		} else {	
			ammo.y = y;
		}
	}
	if (ammo.state > 0) { 
		_rect2 plot;
		byte pal_id;
		for (byte i = 0; i < 46; i++) {
			if (rect[i].state == 1) {
				plot.x = group.x + rect[i].x;
				plot.y = group.y + rect[i].y;
				if (is_collide(ammo.x, ammo.y, plot.x, plot.y, rect[i].width, rect[i].height)) {
					tft.fillRect(ammo.x, ammo.y + ammo.height, ammo.width, ammo.height * 2 , sprite_color[PAL_BACKGROUND]);
					if (i < group.width) {
						pal_id = PAL_INVADER1;
					} else if (i < group.width * 3) {
						pal_id = PAL_INVADER2;
					} else if (i < group.width * 5) {
						pal_id = PAL_INVADER3;
					} else {
						pal_id = PAL_UFO;
					}
					draw_sprite(sprite_invader, INVADER_POP * 2, plot.x, plot.y, sprite_color[pal_id], sprite_color[PAL_BACKGROUND]);
					rect[i].state = 2;
					ammo.y = 0;
					ammo.last_y = 0;
					ammo.state = 0;
					if (effects_on) tone(SND_LEFT, 770, 50); // invader hit
					if (i < 9) {
						play_score += 30;
					} else if (i < 18) {
						play_score += 20;
					} else if (i == 45) {
						play_score += (level_count * 100);
					} else {
						play_score += 10;
					}
					refresh_score();
					if (i < 45) enemy_count--;
					if (enemy_count == 0) {
						level_count++;
						reset_level();
						reset_retry();
					}
				}
			}
		}
	}
}

void paint_pad() {
	pad.update();
	if (pad.id == BUTTON_LEFT) {
		if (act.x > 0) {
			act.dir_x = -2;
			act.x += act.dir_x;
		}
	} else if (pad.id == BUTTON_RIGHT) {
		if (act.x < tft.width() - act.width) {
			act.dir_x = 2;
			act.x += act.dir_x;
		}
	} else if (pad.id == BUTTON_NONE) act.dir_x = 0;
	if (pad.id == BUTTON_B && ammo.state == 0) {
		if (effects_on) tone(SND_LEFT, 700, 50); // fire
		ammo.state = 2;
	}
	draw_sprite(sprite_ship, 0, act.x, act.y, sprite_color[PAL_SHIP], sprite_color[PAL_BACKGROUND]); // player
}

void paint_proj() {
	boolean hit_flag = false;
	boolean draw_flag = false;
	for (byte i = 0; i < 10; i++) {
		if (proj[i].state == 1) {
			draw_flag = false;
			proj[i].last_x = proj[i].x;
			proj[i].last_y = proj[i].y;
			proj[i].y += proj[i].dir_y;
			if (proj[i].y > tft.height() - 16 && proj[i].y < tft.height()) {
				if (proj[i].x > act.x - act.width2 + 2 && proj[i].x < act.x + act.width - 2) {
					hit_flag = true;
				} else {
					draw_flag = true;
				}
			} else if (proj[i].y > tft.height() + proj[i].height) {
				proj[i].x = tft.width();
				proj[i].y = 0;
				proj[i].last_y = 0;
				proj[i].state = 0;
			} else {
				draw_flag = true;
			}
			if (draw_flag) draw_sprite(sprite_projectile, proj[i].y % 2, proj[i].x, proj[i].y, sprite_color[PAL_PROJECTILE], sprite_color[PAL_BACKGROUND]);
		}
	}
	if (hit_flag) {
		act_hit();
	}
}


void update_ufo() {
	if (rect[45].state == 0) {
		if (random(100) == 1) rect[45].state = 1;
	}
	if (rect[45].state == 1) {
		rect[45].x += 1;
		if (rect[45].x % 2 == 0) {
			ufo_effect += ufo_effect_dir;
			if (ufo_effect == 0 || ufo_effect == 5) {
				ufo_effect_dir = -ufo_effect_dir;
				ufo_effect = ufo_effect + ufo_effect_dir;
			}
			if (effects_on) tone(SND_LEFT, 580 + (ufo_effect * 20), 20); // ufo
		}
		draw_sprite(sprite_ufo, 0, rect[45].x, rect[45].y, sprite_color[PAL_UFO], sprite_color[PAL_BACKGROUND]);
		if (rect[45].x > tft.width() + 2) {
			rect[45].x = -24;
			rect[45].state = 0;
		}
	}
}

void action_sprite() {
	_rect2 plot;
	boolean col[group.width + 1];
	int group_left = 9999;
	int group_right = -9999;
	boolean proj_flag = false;
	byte pal_id;
	int j;
	boolean group_flag = false;
	group.frame++;
	if (group.frame == 2) group.frame = 0;
	for (byte i = 0; i < 46; i++) {
		plot.x = group.x + rect[i].x;
		plot.y = group.y + rect[i].y;
		if (rect[i].state > 0) {
			if (rect[i].state == 1) {
				if (i < 45) {
					if (group.dir_x == -1 && plot.x < 2) group_flag = true;
					if (group.dir_x == 1 && plot.x > tft.width() - 16) group_flag = true;
					int j = i % group.width;
					col[j] = true;
					if (i < group.width) {
						pal_id = PAL_INVADER1;
					} else if (i < group.width * 3) {
						pal_id = PAL_INVADER2;
					} else if (i < group.width * 5) {
						pal_id = PAL_INVADER3;
					} else {
						pal_id = PAL_UFO;
					}
					paint_ammo();
					paint_proj();
					paint_pad();
					update_ufo();
					draw_sprite(sprite_invader, (INVADER2 * 2) + group.frame, plot.x, plot.y, sprite_color[pal_id], sprite_color[PAL_BACKGROUND]);
					j = group.width - (i % group.width);
					if (proj_flag && col[j]) {
					//if (random(2) == 1 && proj_flag && col[j]) {
						proj_flag = false;
						add_proj(plot.x + 5, plot.y + 12);
					}
					col[j] = false;
				}
			} else if (rect[i].state == 2) {
				if (i < group.width) {
					pal_id = PAL_INVADER1;							
				} else if (i < group.width * 3) {
					pal_id = PAL_INVADER2;
				} else if (i < group.width * 5) {
					pal_id = PAL_INVADER3;
				} else {
					pal_id = PAL_UFO;
				}
				if (i < 45) {
					draw_sprite(sprite_invader, INVADER_POP * 2, plot.x, plot.y, sprite_color[pal_id], sprite_color[PAL_BACKGROUND]);
					tft.fillRect(plot.x, plot.y, 16, 12, sprite_color[PAL_BACKGROUND]);
				} else {
					draw_sprite(sprite_invader, INVADER_POP * 2, plot.x, plot.y, sprite_color[pal_id], sprite_color[PAL_BACKGROUND]);
					tft.fillRect(plot.x, plot.y, 24, 8, sprite_color[PAL_BACKGROUND]);
				}
				rect[i].state = 0;
				rect[i].x = -24;
			}
		} else if (rect[i].state == 0) {
			j = group.width - (i % group.width);
			if (i < 45 && !col[j] && random(15) == 1) {
				col[j] = true;
				proj_flag = true;
			}
		}
	}
	if (play_state == 0) {
		group.last_x = group.x;
		group.last_y = group.y;
		group.x += group.dir_x;
		if (group_flag == 1) {
			group.dir_x = -group.dir_x;
			group.x = group.x + group.dir_x;
			group.y = group.y + 4;
			if (group.y > 64) {
				group.y = 26;
				act_hit();
			}
		}
	}
	if (scene_id = SCENE_ACTION) {
		play_state = 0;
	}
}


void draw_sprite_flat(byte *data, byte frame_id, int x, int y, uint16_t col, uint16_t backcol) {
	int width = pgm_read_byte(data + 0);
	int height = pgm_read_byte(data + 1);
	int i = 2 + (frame_id * height * (width / 8));
	int x0;
	int y0;
	uint16_t c;
	for (int py = 0; py < height; py++) {
		for (int j = 0; j < width / 8; j++) {
			for (int px = 0; px < 8; px++) {
				if (bitRead(pgm_read_byte(data + i), 7 - px) == 0) {
					c = backcol;
				} else {
					c = col;
				}
				if (c != -1) {				
					x0 = x + px + (j * 8);
					y0 = y + py;
					tft.drawPixel(x0, y0, c);
				}
			}
			i++;
		}
	}
}


void sprite_pixel(byte *data, int i, int x, int y, int px, int py, int j, uint16_t forecolor, uint16_t backcolor) {
	uint16_t c = forecolor;
	int x0;
	int y0;
	if (bitRead(pgm_read_byte(data + i), 7 - px) == 0) {
		c = backcolor;
	}
	if (c != -1) {
		x0 = x + px + (j * 8);
		y0 = y + py;
		tft.drawPixel(x0, y0, c);
	}
}

void draw_sprite(byte *data, byte frame_id, int x, int y, uint16_t forecolor, uint16_t backcolor) {
	int width = pgm_read_byte(data + 0);
	int height = pgm_read_byte(data + 1);
	int i = 2 + (frame_id * height * (width / 8));
	int k = i;
	for (int px = 0; px < 4; px++) {
		for (int py = 0; py < height; py++) {
			for (int j = 0; j < width / 8; j++) {
				i = 2 + (frame_id * height * (width / 8));
				i += j;
				i += py * width / 8;
				sprite_pixel(data, i, x, y, px,	 py, j, forecolor, backcolor);
				sprite_pixel(data, i, x, y, (3 - px) + 4, py, j, forecolor, backcolor);
			}
		}
	}
}

void action_music() {
	if (music_on) {
		int freq = 80 + (music_beat * 4);
		tone(SND_LEFT, freq, 50); // music
		music_beat--;
		if (music_beat == 0) {
			music_beat = 4;
			refresh_score();
		}
	}
}

void scene_action() {
	action_music();
	action_sprite();
}

void splash_matchygames() {
	tft.fillScreen(COL_BLUE);
	tft.setTextColor(COL_CYAN, COL_BLUE);
	tft.setCursor(20, 55);
	tft.print("M A T C H Y G A M E S");
	tft.setTextColor(sprite_color[PAL_FOREGROUND], sprite_color[PAL_BACKGROUND]);
	if (effects_on) tone(SND_LEFT, 4000, 300);
}

void splash_hackaday() {
	draw_sprite(sprite_hackaday, 0, 16, 0, COL_WHITE, COL_BLACK);
}

void title_header() {
	byte y = 26;
	draw_sprite(sprite_title_outline, 0, 0, y, COL_BLUE, -1);
	draw_sprite(sprite_title, 0, 0, y + 3, COL_ORANGE, -1);
	draw_sprite(sprite_title, 0, 0, y + 7, COL_RED, -1);
	draw_sprite(sprite_title_outline, 0, 0, y + 7, COL_YELLOW, -1);
}

void title_detail() {
	byte x = 40;
	refresh_score();
	tft.setCursor(70, 30);
	tft.print("PLAY");
	tft.setCursor(40, 40);
	tft.print("SPACE INVADERS");
	tft.setCursor(20, 60);
	tft.print("*SCORE ADVANCE TABLE*");
	draw_sprite(sprite_ufo, 0, x - 4, 74,   sprite_color[PAL_UFO], sprite_color[PAL_BACKGROUND]);
	draw_sprite(sprite_invader, INVADER1 * 2, x, 80,  sprite_color[PAL_INVADER1], sprite_color[PAL_BACKGROUND]);
	draw_sprite(sprite_invader, INVADER2 * 2, x, 90,  sprite_color[PAL_INVADER2], sprite_color[PAL_BACKGROUND]);
	draw_sprite(sprite_invader, INVADER3 * 2, x, 100, sprite_color[PAL_INVADER3], sprite_color[PAL_BACKGROUND]);
	x = 56;
	tft.setCursor(x, 74);
	tft.print("=? MYSTERY");
	tft.setCursor(x, 84);
	tft.print("=30 POINTS");
	tft.setCursor(x, 94);
	tft.print("=20 POINTS");
	tft.setCursor(x, 104);
	tft.print("=10 POINTS");
}

void scene_title() {
	long t = 0;
	while (pad.id != BUTTON_B) {
		t++;
		if (t == ((sub_id + 1) * 10000L)) {
			t = 0;
			sub_id++;
			if (sub_id == 4) sub_id = 2;
			tft.fillScreen(sprite_color[PAL_BACKGROUND]);
			switch (sub_id) {
				case 1:
					splash_hackaday();
					break;
				case 2:
					title_header();					
					break;
				case 3:
					title_detail();
					break;
			}
		}
		pad.update();
	}
	sub_id = 2;
	scene_id = SCENE_INTRO;
	tft.fillScreen(sprite_color[PAL_BACKGROUND]);
}

void scene_intro() {
	uint16_t foreground_color;
	for (byte i = 0; i < 32; i++) {
		if (i % 4 == 0) {
			foreground_color = COL_WHITE;
		} else {
			foreground_color = COL_BLACK;
		}
		tft.setTextColor(foreground_color, sprite_color[PAL_BACKGROUND]);
		tft.setCursor(50, 60);
		tft.print("GET READY");
	}
	tft.setTextColor(sprite_color[PAL_FOREGROUND], sprite_color[PAL_BACKGROUND]);
	reset_game();
	reset_level();
	scene_id = SCENE_ACTION;
}

void scene_about() {
	tft.setCursor(90, 90);
	tft.print("ABOUT");
	if (pad.id == BUTTON_B) {
		scene_id = SCENE_TITLE;
	}
}

void scene_over() {
	uint16_t foreground_color = COL_RED;
	tft.setTextColor(foreground_color, sprite_color[PAL_BACKGROUND]);
	for (byte i = 0; i < 128; i++) {
		if (i % 2 == 0) {
			foreground_color = COL_RED;
		} else {
			foreground_color = COL_BLACK;
		}
		tft.setTextColor(foreground_color, sprite_color[PAL_BACKGROUND]);
		tft.setCursor(50, 90);
		tft.print("GAME OVER");
	}
	tft.setTextColor(sprite_color[PAL_FOREGROUND], sprite_color[PAL_BACKGROUND]);
	scene_id = SCENE_TITLE;
	tft.fillScreen(sprite_color[PAL_BACKGROUND]);
}

void loop() {
	switch (scene_id) {
		case SCENE_TITLE:
			scene_title();
			break;
		case SCENE_INTRO:
			scene_intro();
			break;
		case SCENE_ACTION:
			scene_action();
			break;
		case SCENE_OVER:
			scene_over();
			break;
		case SCENE_ABOUT:
			scene_about();
			break;
	}
}





